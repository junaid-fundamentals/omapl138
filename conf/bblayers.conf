## conf/bblayers.conf
```bitbake
# POKY_BBLAYERS_CONF_VERSION is increased each time build/conf/bblayers.conf
# changes incompatibly
POKY_BBLAYERS_CONF_VERSION = "2"

BBPATH = "${TOPDIR}"
BBFILES ?= ""

BBLAYERS ?= " \
  /home/junaid/poky/meta \
  /home/junaid/poky/meta-poky \
  /home/junaid/poky/meta-yocto-bsp \
  /home/junaid/poky/meta-openembedded/meta-oe \
  /home/junaid/poky/meta-openembedded/meta-python \
  /home/junaid/poky/meta-arm/meta-arm \
  /home/junaid/poky/meta-ti \
  "
```
